## base_external/configs/x86_64_qemu_defconfig
```kconfig
BR2_x86_nocona=y
BR2_KERNEL_HEADERS_4_15=y
BR2_TOOLCHAIN_BUILDROOT_WCHAR=y
BR2_ROOTFS_OVERLAY="../base_external/rootfs-overlay"
BR2_ROOTFS_POST_IMAGE_SCRIPT="../base_external/scripts/post-image.sh"
BR2_LINUX_KERNEL=y
BR2_LINUX_KERNEL_USE_CUSTOM_CONFIG=y
BR2_LINUX_KERNEL_CUSTOM_CONFIG_FILE="../base_external/configs/linux_kernel_defconfig"
BR2_LINUX_KERNEL_INSTALL_TARGET=y
BR2_PACKAGE_OPENSSH=y
BR2_TARGET_ROOTFS_EXT2=y
# BR2_TARGET_ROOTFS_TAR is not set
BR2_TARGET_GRUB2=y
BR2_PACKAGE_HOST_GENIMAGE=y
```

## base_external/package/ecen5013-hello-world/Config.in
```kconfig
config BR2_PACKAGE_ECEN5013_HELLO_WORLD
	bool "ecen5823-hello-world"
	help
	  Hello world example for ECEN5013, used to introduce
	  Buildroot external trees and package builds.
```
